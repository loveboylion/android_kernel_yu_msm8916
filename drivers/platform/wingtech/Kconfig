## drivers/platform/wingtech/Kconfig
```kconfig
# Wingtech configuration options

config MACH_WINGTECH
	bool "Wingtech device"
	depends on ARCH_MSM
	help
	  Support for Wingtech products

config MACH_WINGTECH_MSM8916
	bool "Wingtech MSM8916"
	depends on ARCH_MSM8916
	select MACH_WINGTECH
	help
	  Support for MSM8916 Wingtech variants

menu "Wingtech board selection"

config MACH_LETTUCE
	bool "YU Yuphoria board"
	select MACH_WINGTECH_MSM8916
	help
	  Support for Wingtech Yuphoria variant

endmenu
```

## drivers/platform/yulong/Kconfig
```kconfig
# Yulong/Coolpad configuration options

config MACH_YULONG
	bool "Yulong device"
	depends on ARCH_MSM
	help
	  Support for Yulong products

config MACH_YULONG_MSM8939
	bool "Yulong MSM8939"
	depends on ARCH_MSM8916
	select MACH_YULONG
	help
	  Support for MSM8939 Yulong variants

config MACH_TOMATO
	bool "YU Yureka Board"
	select MACH_YULONG_MSM8939
	help
	  Support for Yulong YU Yureka Board variant
```
